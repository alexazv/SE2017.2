## CMakeLists.txt
```
set(ENV{ZEPHYR_BASE} /home/alexandre/Zephyr/zephyr)
set(ENV{ZEPHYR_TOOLCHAIN_VARIANT} zephyr)
set(ENV{ZEPHYR_SDK_INSTALL_DIR} /opt/zephyr-sdk)

set(BOARD "bbc_microbit")

include($ENV{ZEPHYR_BASE}/cmake/app/boilerplate.cmake NO_POLICY_SCOPE)
#include($ENV{ZEPHYR_BASE}/boards/common/pyocd.board.cmake)
project(FinalProject)

#message(WARNING "Main file: ${PROJECT_SOURCE_DIR}/src/main.c")

# Generate version file
include(build.version.cmake NO_POLICY_SCOPE)

include_directories(
    "${PROJECT_BINARY_DIR}/include/generated"
    "${PROJECT_SOURCE_DIR}/include"
     "$ENV{ZEPHYR_BASE}/include"
    )

#FILE(GLOB app_sources src/*.c)

list(APPEND SOURCES
   "${PROJECT_SOURCE_DIR}/src/main.c"
   "${PROJECT_SOURCE_DIR}/src/view/display.c"
   "${PROJECT_SOURCE_DIR}/src/view/i2c_device.c"
   "${PROJECT_SOURCE_DIR}/src/view/i2c_util.c"
   "${PROJECT_SOURCE_DIR}/src/view/thermometer.c"
   "${PROJECT_SOURCE_DIR}/src/view/button.c"
   
#"${PROJECT_SOURCE_DIR}/src/controller/bas.c"
#"${PROJECT_SOURCE_DIR}/src/controller/dis.c"
#"${PROJECT_SOURCE_DIR}/src/controller/bluetooth.c"
#"${PROJECT_SOURCE_DIR}/src/controller/bluetooth_hci_usart.c"

   "${PROJECT_SOURCE_DIR}/src/model/compass.c"
   "${PROJECT_SOURCE_DIR}/src/model/accelerometer.c"
   "${PROJECT_SOURCE_DIR}/src/model/state_machine.c"
 )


# Schedule a new version file generation after every build
add_custom_command(
    TARGET app
    POST_BUILD
    COMMAND "${CMAKE_COMMAND}"
    -DPROJECT_SOURCE_DIR=${PROJECT_SOURCE_DIR}
    -DPROJECT_BINARY_DIR=${PROJECT_BINARY_DIR}
    -P ${PROJECT_SOURCE_DIR}/build.version.cmake
    )

target_sources(app PRIVATE ${SOURCES})
```

## prj.conf
```kconfig
CONFIG_GPIO=y
CONFIG_MICROBIT_DISPLAY=y
CONFIG_SYS_CLOCK_TICKS_PER_SEC=250
CONFIG_MICROBIT_DISPLAY_PIN_GRANULARITY=y
CONFIG_SENSOR=y
CONFIG_STDOUT_CONSOLE=y

CONFIG_I2C=y
CONFIG_I2C_INIT_PRIORITY=60
CONFIG_I2C_0=y
CONFIG_I2C_GPIO=y
CONFIG_I2C_GPIO_0=y
CONFIG_I2C_GPIO_0_SDA_PIN=20
CONFIG_I2C_GPIO_0_SCL_PIN=19

CONFIG_SYS_LOG=y
CONFIG_SYS_LOG_DEFAULT_LEVEL=4
CONFIG_SYS_LOG_SHOW_COLOR=y

CONFIG_MINIMAL_LIBC=n
CONFIG_NEWLIB_LIBC_FLOAT_PRINTF = y
CONFIG_NATIVE_APPLICATION = y
CONFIG_NEWLIB_LIBC=y


CONFIG_ENTROPY_GENERATOR=y
CONFIG_TEST_RANDOM_GENERATOR=y
CONFIG_BT=y
CONFIG_BT_PERIPHERAL=y
CONFIG_BT_DEVICE_NAME="Final Project Microbit"
CONFIG_BT_DEVICE_APPEARANCE=1157

#CONFIG_CONSOLE=n
#CONFIG_STDOUT_CONSOLE=n
#CONFIG_UART_CONSOLE=n
#CONFIG_GPIO=y
#CONFIG_SERIAL=y
#CONFIG_UART_INTERRUPT_DRIVEN=y
#CONFIG_UART_NRF5_BAUD_RATE=115200
#CONFIG_UART_NRF5_FLOW_CONTROL=n
#CONFIG_MAIN_STACK_SIZE=512
#CONFIG_IDLE_STACK_SIZE=256
#CONFIG_ISR_STACK_SIZE=512
#CONFIG_BT_HCI_RAW=y
#CONFIG_BT_MAX_CONN=20
```

## src/main.c
```c
/**
 *  @file    main.c
 *  @author  Alexandre Azevedo
 *  @date    18/05/2018
 *
 */

#include "button.h"
#include "state_machine.h"
#include "version.h"
#include <logging/sys_log.h>

static event_t ce;
volatile static int event_changed;

/**
 * @brief buttonA_pressed
 * ISR to be called when button A is pressed
 *
 * @param gpiob
 * @param cb
 * @param pins
 */
void buttonA_pressed(struct device *gpiob, struct gpio_callback *cb,
            u32_t pins)
{
    state_machine_change_state(BUTTON_A);

}
/**
 * @brief buttonB_pressed
 * ISR to be called when button B is pressed
 * @param gpiob
 * @param cb
 * @param pins
 */
void buttonB_pressed(struct device *gpiob, struct gpio_callback *cb,
            u32_t pins)
{
    state_machine_change_state(BUTTON_B);
}

int main(){

  SYS_LOG_WRN("Firmware version: v%d.%d.%d",
                   VERSION_MAJOR, VERSION_MINOR, VERSION_BUILD);

    button_configure_init();
    button_A_set_callback(buttonA_pressed);
    button_B_set_callback(buttonB_pressed);

    compass_init();
    accelerometer_init();

    while(1){

        get_current_state()->action();

    }


    return 0;
}
```

## include/accelerometer.h
```c
/**
 *  @file    display.c
 *  @author  Alexandre Azevedo
 *  @date    27/05/2018
 *
 */


#ifndef ACCELEROMETER_FINALPROJECT_H
#define ACCELEROMETER_H

#include "version.h"
#include "i2c_device.h"
#include "display.h"
#include <stdint.h>
#include <math.h>


typedef union {

    /**
     * @brief
     * Raw data for the raw values
     * of the accelerometer as 3 separate
     * 16-bit values
     */
    struct {
        int16_t x;
        int16_t y;
        int16_t z;
    } axis;
    /**
     * @brief data_signed
     *
     * Raw data for the raw values
     * of the accelerometer as a 16-bit
     * array
     */
    uint16_t data_signed[3];
    /**
     * @brief data_raw
     *
     * Raw data for the raw values
     * of the accelerometer with each
     * value separated in two 8-bit integer,
     * as it is read from the device
     */
    uint8_t data_raw[6];
} accelerometer_raw_data_t;

/**
 * @brief calculate_tilt
 * Calculate roll and pitch of the device in degrees based on raw values
 * @param x_raw - raw x value
 * @param y_raw - raw y value
 * @param z_raw - raw z value
 */
static void calculate_tilt(accelerometer_raw_data_t * data);

/**
 * @brief print_tilt
 * Show current tilt as a pixel on the display
 * @param roll - roll of device
 * @param pitch - pitch of the device
 */
void show_accelerometer(void);

/**
 * @brief show_accelerometer
 * Show current tilt as a pixel on the display
 */
static void print_tilt(double_t roll, double_t pitch);


#endif //ACCELEROMETER_H
```

## include/button.h
```c
#ifndef BUTTON_FINALPROJECT_H
#define BUTTON_FINALPROJECT_H

#include <zephyr.h>
#include <board.h>
#include <device.h>
#include <gpio.h>
#include <misc/util.h>
#include <misc/printk.h>


//Configure Button A
/* change this to use another GPIO port */
#ifdef SW0_GPIO_NAME
#define PORT0	SW0_GPIO_NAME
#else
#error SW0_GPIO_NAME needs to be set in board.h
#endif

/* change this to use another GPIO pin */
#ifdef SW1_GPIO_PIN
#define PIN0     SW0_GPIO_PIN
#else
#error SW0_GPIO_PIN needs to be set in board.h
#endif

/* change to use another GPIO pin interrupt config */
#ifdef SW0_GPIO_INT_CONF
#define EDGE0    SW0_GPIO_INT_CONF
#else
/*
 * If SW0_GPIO_INT_CONF not defined used default EDGE value.
 * Change this to use a different interrupt trigger
 */
#define EDGE0    (GPIO_INT_EDGE | GPIO_INT_ACTIVE_LOW)
#endif

/* change this to enable pull-up/pull-down */
#ifdef SW1_GPIO_PIN_PUD
#define PULL_UP0 SW0_GPIO_PIN_PUD
#else
#define PULL_UP0 0
#endif


//Configure Button B
/* change this to use another GPIO port */
#ifdef SW1_GPIO_NAME
#define PORT1	SW1_GPIO_NAME
#else
#error SW1_GPIO_NAME needs to be set in board.h
#endif

/* change this to use another GPIO pin */
#ifdef SW1_GPIO_PIN
#define PIN1     SW1_GPIO_PIN
#else
#error SW1_GPIO_PIN needs to be set in board.h
#endif

/* change to use another GPIO pin interrupt config */
#ifdef SW1_GPIO_INT_CONF
#define EDGE1    SW1_GPIO_INT_CONF
#else
/*
 * If SW1_GPIO_INT_CONF not defined used default EDGE value.
 * Change this to use a different interrupt trigger
 */
#define EDGE1    (GPIO_INT_EDGE | GPIO_INT_ACTIVE_LOW)
#endif

/* change this to enable pull-up/pull-down */
#ifdef SW1_GPIO_PIN_PUD
//#define PULL_UP SW0_GPIO_PIN_PUD
#define PULL_UP1 SW1_GPIO_PIN_PUD
#else
#define PULL_UP1 0
#endif


/* Sleep time */
#define SLEEP_TIME	500

/**
 * @brief button_B_set_callback
 * Sets a ISR to be called when button B is triggered
 * @param callback - ISR to be called
 */
void button_A_set_callback(gpio_callback_handler_t callback);

/**
 * @brief button_A_set_callback
 * Sets a ISR to be called when button A is triggered
 * @param callback - ISR to be called
 */
void button_B_set_callback(gpio_callback_handler_t callback);

/**
 * @brief button_configure_init
 * Configure ports for buttons A and B
 *
 */
void button_configure_init(void);


#endif //DISPLAY_FINALPROJECT_H
```

## include/compass.h
```c
/**
 *  @file    display.c
 *  @author  Alexandre Azevedo
 *  @date    27/05/2018
 *
 */


#ifndef COMPASS_FINALPROJECT_H
#define COMPASS_FINALPROJECT_H

#include <stdint.h>
#include "math.h"
#include "display.h"
#include <misc/printk.h>
#include "version.h"
#include "i2c_util.h"

typedef enum {
    NORTH,
    WEST,
    SOUTH,
    EAST,
    NORTHWEST,
    NORTHTEAST,
    SOUTHWEST,
    SOUTHEAST,
    UNDEFINED
} direction_t;

typedef union {
    struct {
        int16_t x;
        int16_t y;
        int16_t z;
    } axis;
    uint16_t data_signed[3];
    uint8_t data_raw[6];
} compass_raw_data_t;


/**
 * @brief calculate_direction
 *
 * Calculate north direction based on raw
 * magnetometer data
 *
 * @param data
 * Raw magnetometer data
 *
 * @return
 * The calculated cardinal direction
 */
direction_t calculate_direction(compass_raw_data_t *data);

/**
 * @brief show_compass
 * Show direction of magnetic north on the display
 */
void show_compass(void);

/**
 * @brief compass_direction_sprite_get
 * Get the sprite for a cardinal direction to be shown on the display
 * @param direction
 * Cardinal direction requested
 * @return
 * Sprite for the cardinal direction
 */
struct mb_display * compass_direction_sprite_get(direction_t direction);

#endif //COMPASS_FINALPROJECT_H
```

## include/compass_direction.h
```c
#ifndef COMPASS_DIRECTION_FINALPROJECT_H
#define COMPASS_DIRECTION_FINALPROJECT_H

#include <stdint.h>
#include "math.h"
#include "display.h"
#include <misc/printk.h>

typedef enum {
    NORTH,
    WEST,
    SOUTH,
    EAST,
    NORTHWEST,
    NORTHTEAST,
    SOUTHWEST,
    SOUTHEAST
} direction_t;

direction_t calculate_direction(int16_t *data);

struct mb_display * direction_sprite(direction_t direction);

#endif //COMPASS_DIRECTION_FINALPROJECT_H
```

## include/display.h
```c
//Code by Alexandre Azevedo
//Code created in 19/05/2018

#ifndef DISPLAY_FINALPROJECT_H
#define DISPLAY_FINALPROJECT_H

#define SCREEN_DURATION 300

#include <zephyr.h>
#include <misc/printk.h>
#include <board.h>
#include <gpio.h>
#include <device.h>
#include <display/mb_display.h>


/**
 * @brief print_string_to_display
 * Scrolls text on the display
 * @param text - Text to be shown
 * @param ms_duration - Duration of one character
 */
void print_string_to_display(const char * text, int ms_duration);

/**
 * @brief print_int_to_display
 * Scrolls a number on the screen
 * @param number Integer to be shown on the display
 * @param ms_duration - Duration of one character
 */
void print_int_to_display(uint8_t number, int ms_duration);

/**
 * @brief print_double_to_display
 * Displays a floating-point number on the display
 * @param number - Double to be shown on display
 * @param ms_duration - Duration of one character
 */
void print_double_to_display(double number, int ms_duration);

/**
 * @brief print_image_to_display
 * Shows an image on the display for 1 second
 * @param img - Image to be displayed
 */
void print_image_to_display(const struct mb_image *img);

/**
 * @brief clear_display
 *
 * Resets the display
 *
 */
void clear_display();

#endif //DISPLAY_FINALPROJECT_H
```

## include/i2c_device.h
```c
#ifndef I2C_DEVICE_FINALPROJECT_H
#define I2C_DEVICE_FINALPROJECT_H

#include "version.h"
#include "i2c_util.h"
#include <stdint.h>

/**
 * @brief accelerometer_init
 *
 * Configure the accelerometer device for use
 */
void accelerometer_init(void);

/**
 * @brief accelerometer_standby
 *
 * Change accelerometer device status to "standby"
 */
void accelerometer_standby(void);

/**
 * @brief accelerometer_active
 * Change accelerometer device status to active
 */
void accelerometer_active(void);

/**
 * @brief read_from_accelerometer
 * Read the raw x, y and z values from the accelerometer device
 * @param dst - destination of the x, y, z data.
 */
void read_from_accelerometer(uint8_t *data);

/**
 * @brief compass_init
 *
 * Configure the magnetometer device for use
 */
void compass_init(void);

/**
 * @brief compass_active
 *
 *Change magnometer device status to "active"
 */
void compass_active(void);

/**
 * @brief compass_standby
 *
 * Change magnetometer device status to "standby"
 */
void compass_standby(void);
/**
 * @brief read_from_compass
 * Read the raw x, y and z values from the magnetometer device
 *
 * @param data - destination for the raw x, y, z data.
 */
void read_from_compass(uint8_t * data);



#endif //I2C_DEVICE_FINALPROJECT_H
```

## include/i2c_driver.h
```c
#ifndef I2C_FINALPROJECT_H
#define I2C_FINALPROJECT_H

#include "version.h"
#include "i2c_util.h"

void i2c_init();

uint8_t read_from_accelerometer();

void read_from_compass(uint16_t *dst);

#endif //I2C_FINALPROJECT_H
```

## include/state_machine.h
```c
/**
 *  @file    display.c
 *  @author  Alexandre Azevedo
 *  @date    25/05/2018
 *
 */

#ifndef STATE_MACHINE_FINALPROJECT_H
#define STATE_MACHINE_FINALPROJECT_H

typedef
/**
/** * @brief state_t
 * Enum of possible device states
/** */
enum {
    TEXT_DISPLAY,
    ACCELEROMETER,
    COMPASS,
    THERMOMETER,
    BLUETOOTH
} state_t;


typedef
/**
/** * @brief event_t
 *  Enum of triggerable events
 *
/** */enum {
    BUTTON_A,
    BUTTON_B
} event_t;

typedef

struct {
    const char * state_name;
    state_t events[2];
    void (*action)(void);
} state_machine_t;

/**
 * @brief scroll_Text
 * Shows "ECOM042.2017.2" scrolling in the display
 */
void state_machine_change_state(event_t event);

void scroll_Text(void);

//TODO: implement bluetooth function
static void bluetooth(void);

/**
 * @brief
 *Shows current temperature in Celsius on the display
 */
void show_temperature(void);

/**
 * @brief get_current_state
 * Get the current machine state from the state machine
 * @return
 * Current machine state from the state machine
 */
state_machine_t * get_current_state(void);

#endif //STATE_MACHINE_FINALPROJECT_H
```

## include/thermometer.h
```c
//Code by Alexandre Azevedo
//Code created in 19/05/2018


#ifndef THERMOMETER_FINALPROJECT_H
#define THERMOMETER_FINALPROJECT_H

#include <zephyr.h>
#include <sensor.h>
#include <stdio.h>

/**
 * @brief thermometer_get_temperature_as_double
 * Read current temperature in celsius from the thermometer device
 *
 * @return Temperature in celsius
 */
double thermometer_get_temperature_as_double(void);

#endif //THERMOMETER_FINALPROJECT_H
```

## src/accelerometer.c
```c
#include "accelerometer.h"

#define ACC_DEV_ADDR     0x1D
#define ACC_WHO_AM_I_REG 0x0D
#define ACC_TEST_VALUE   0x5A

#define PI 3.141592654

#define MIN 20
#define MIDDLE 45

static struct i2c_dev acc;

static struct mb_image map  = MB_IMAGE({ 0, 0, 0, 0, 0 },
                                    { 0, 0, 0, 0, 0 },
                                    { 0, 0, 0, 0, 0 },
                                    { 0, 0, 0, 0, 0 },
                                    { 0, 0, 0, 0, 0 });
void accelerometer_init(){
    i2c_util_dev_init(&acc, ACC_DEV_ADDR, "ACC", ACC_WHO_AM_I_REG,
                            ACC_TEST_VALUE);

    uint8_t config;

    //accelerometer_standby();

    /*
    //clear FRead bit in CTRL1
    i2c_util_read_bytes(&acc, 0x2A, config, 1);
    config = config | ~1;
    i2c_util_write_bytes(&acc, 0x2A, config, 1);
*/
    accelerometer_active();
}

void accelerometer_standby(){
    uint8_t config;
    //clear active bit
    config = 0x00;
    i2c_util_write_bytes(&acc, 0x2A, &config, sizeof(config));

}

void accelerometer_active(){
    uint8_t config;
    //read from CTRL1
    //i2c_util_read_bytes(&acc, 0x2A, config, 1);

    //set active bit
    config = 0x01;//config | 1;
    i2c_util_write_bytes(&acc, 0x2A, &config, sizeof(config));
}



void read_from_accelerometer(int16_t *dst){
    static uint8_t data[6];

    i2c_util_read_bytes(&acc, 0x01, data, 6);

    for(int i = 0; i < 6; i+=2){
        dst[i/2] = data[i] << 2 | data[i+1] >> 6;
    }



    /*printk("Acc: X = %d, ", dst[0]);

    printk("Y = %d, ", dst[1]);

    printk("Z = %d\n", dst[2]);

    */

}

void calculate_tilt(int16_t x, int16_t y, int16_t z){

    //printk("x = %d, y = %d, z = %d\n", x, y, z);

      double_t x_g = ((double_t) x)*0.0038;
      double_t y_g = ((double_t) y)*0.0038;
      double_t z_g = ((double_t )z)*0.0038;

      //double_t roll = atan(y_g/z_g) * 180.0/PI;
      double_t roll = atan(y_g/sqrt((x_g * x_g) + (z_g * z_g))) * 180.0/PI;
      double_t pitch = atan(x_g/sqrt((y_g * y_g) + (z_g * z_g))) * 180.0/PI;

      printk("pitch = %d, roll = %d\n", (int)pitch, (int)roll);

      print_tilt(roll, pitch);
}

void print_tilt(double_t roll, double_t pitch){

    //positioned center of center
    int x, y;

    if(roll <= MIN){
        y = 2;
    } else if(MIN < roll && roll <= MIDDLE){
        y = 4;
    } else{
        y = 0;
    }

    if(pitch <= MIN){
        x = 2;
    } else if(MIN < pitch && pitch <= MIDDLE){
        x = 4;
    } else{
        x = 0;
    }


    /*if(roll <= MIN && pitch <= MIN){
        x = 2;
        y = 2;
    } else if(roll <= MIN){
        y = 2;
        if(MIN < pitch && pitch <= MIDDLE)
            //left
            x = 4;
        else
            //right
            x = 0;
    } else if(pitch <= MIN){
        x = 2;
        if(MIN < roll && roll <= MIDDLE)
            //left
            y = 4;
        else
            //right
            y = 0;
    } else {
        if(MIN < pitch && pitch <= MIDDLE)
            //left
            x = 4;
        else
            //right
            x = 0;
        if(MIN < roll && roll <= MIDDLE)
            //left
            y = 4;
        else
            //right
            y = 0;
    }*/

    map.row[y] = (1 << x);

    print_image_to_display(&map);

    map.row[y] = 0;
}
```

## src/button.c
```c
/*
 * Copyright (c) 2016 Open-RnD Sp. z o.o.
 *
 * SPDX-License-Identifier: Apache-2.0
 */

#include "button.h"

static struct gpio_callback gpio_cb0;
static struct gpio_callback gpio_cb1;
static struct device *gpiob0;
static struct device *gpiob1;

void button_A_set_callback(gpio_callback_handler_t callback){
    gpio_init_callback(&gpio_cb0, callback, BIT(PIN0));

    gpio_add_callback(gpiob0, &gpio_cb0);
    gpio_pin_enable_callback(gpiob0, PIN0);
}

void button_B_set_callback(gpio_callback_handler_t callback){
    gpio_init_callback(&gpio_cb1, callback, BIT(PIN1));

    gpio_add_callback(gpiob1, &gpio_cb1);
    gpio_pin_enable_callback(gpiob1, PIN1);
}

void button_configure(){
    printk("Press the user defined button on the board\n");
    gpiob0 = device_get_binding(PORT0);
    gpiob1 = device_get_binding(PORT1);
    if (!gpiob0) {
        printk("error at port 0\n");
        return;
    }

    if (!gpiob1) {
        printk("error at port 1\n");
        return;
    }

    gpio_pin_configure(gpiob0, PIN0,
               GPIO_DIR_IN | GPIO_INT |  PULL_UP0 | EDGE0);

    gpio_pin_configure(gpiob1, PIN1,
               GPIO_DIR_IN | GPIO_INT |  PULL_UP1 | EDGE1);

}
```

## src/compass.c
```c
#include "compass.h"

#define COMPASS_DEV_ADDR     0x0e
#define COMPASS_WHO_AM_I_REG 0x07
#define COMPASS_TEST_VALUE   0xC4

#define PI 3.141592654

static struct i2c_dev compass;

void compass_init(){
    i2c_util_dev_init(&compass, COMPASS_DEV_ADDR, "COMPASS",
                            COMPASS_WHO_AM_I_REG, COMPASS_TEST_VALUE);
}

void compass_active(){

}

void configCompass(){
    uint8_t config;

    //standby
    config = 0;
    i2c_util_write_bytes(&compass, 0x10, &config, sizeof(config));

    //continuous read
    config = config =  0x80;
    i2c_util_write_bytes(&compass, 0x11, &config, sizeof(config));

    //wake
    config = 0x01;
    i2c_util_write_bytes(&compass, 0x10, &config, sizeof(config));
}

//dst must have at least 3 bytes
void read_from_compass(int16_t *dst){
    static uint8_t data[6];

    configCompass();

    i2c_util_read_bytes(&compass, 0x01, data, sizeof(data));

    for(int i = 0; i < 6; i+=2){
        dst[i/2] = (data[i] << 8) | data[i+1];
    }

    printk("Compass: X = %d, ", dst[0]);

    printk("Y = %d, ", dst[1]);

    printk("Z = %d\n", dst[2]);
}

direction_t calculate_direction(int16_t * data){
    double_t x = data[0];
    double_t y = data[1];

    double_t angle = x == 0? (y < 0 ? 90 : 0) : (atan(y/x)*180.0)/PI;

    if(angle < 0)
        angle = 360 + angle;

    if(angle >= 337.25 || angle < 22.5)
        return NORTH;
    else if(angle >= 292.5 && angle < 337.25)
        return NORTHWEST;
    else if(angle >= 247.5 && angle < 292.5)
        return WEST;
    else if(angle >= 202.5 && angle < 247.5)
        return SOUTHWEST;
    else if(angle >= 157.5 && angle < 202.5)
        return SOUTH;
    else if(angle >= 112.5 && angle < 157.5)
        return SOUTHEAST;
    else if(angle >= 67.5 && angle < 112.5)
        return EAST;
    else if(angle >= 0 && angle < 67.5)
        return NORTHTEAST;
    else
        return UNDEFINED;

}

static struct mb_image north  = MB_IMAGE({ 0, 0, 1, 0, 0 },
                                    { 0, 0, 1, 0, 0 },
                                    { 0, 0, 1, 0, 0 },
                                    { 0, 0, 0, 0, 0 },
                                    { 0, 0, 0, 0, 0 });
static struct mb_image south  = MB_IMAGE({ 0, 0, 0, 0, 0 },
                                    { 0, 0, 0, 0, 0 },
                                    { 0, 0, 1, 0, 0 },
                                    { 0, 0, 1, 0, 0 },
                                    { 0, 0, 1, 0, 0 });

static struct mb_image west  = MB_IMAGE({ 0, 0, 0, 0, 0 },
                                    { 0, 0, 0, 0, 0 },
                                    { 1, 1, 1, 0, 0 },
                                    { 0, 0, 0, 0, 0 },
                                    { 0, 0, 0, 0, 0 });

static struct mb_image east  = MB_IMAGE({ 0, 0, 0, 0, 0 },
                                    { 0, 0, 0, 0, 0 },
                                    { 0, 0, 1, 1, 1 },
                                    { 0, 0, 0, 0, 0 },
                                    { 0, 0, 0, 0, 0 });

static struct mb_image north_west  = MB_IMAGE({ 1, 0, 0, 0, 0 },
                                    { 0, 1, 0, 0, 0 },
                                    { 0, 0, 1, 0, 0 },
                                    { 0, 0, 0, 0, 0 },
                                    { 0, 0, 0, 0, 0 });

static struct mb_image north_east  = MB_IMAGE({ 0, 0, 0, 0, 1 },
                                    { 0, 0, 0, 1, 0 },
                                    { 0, 0, 1, 0, 0 },
                                    { 0, 0, 0, 0, 0 },
                                    { 0, 0, 0, 0, 0 });

static struct mb_image south_west  = MB_IMAGE({ 1, 0, 0, 0, 0 },
                                    { 0, 1, 0, 0, 0 },
                                    { 0, 0, 1, 0, 0 },
                                    { 0, 0, 0, 0, 0 },
                                    { 0, 0, 0, 0, 0 });

static struct mb_image south_east  = MB_IMAGE({ 0, 0, 0, 0, 0 },
                                    { 0, 0, 0, 0, 0 },
                                    { 0, 0, 1, 0, 0 },
                                    { 0, 0, 0, 1, 0 },
                                    { 0, 0, 0, 0, 1 });
static struct mb_image undefined  = MB_IMAGE({ 0, 0, 1, 0, 0 },
                                    { 0, 0, 1, 0, 0 },
                                    { 1, 1, 1, 1, 1 },
                                    { 0, 0, 1, 0, 0 },
                                    { 0, 0, 1, 0, 0 });

static struct mb_image * direction_sprites[] = {&north, &west, &south, &east,
                                        &north_west, &north_east,
                                         &south_west, &south_east, &undefined};

struct mb_display * direction_sprite(direction_t direction){

    //printk("%d\n", direction);
    return direction_sprites[direction];
}
```
